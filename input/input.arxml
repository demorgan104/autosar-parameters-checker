AUTOSAR XML (schema 00048)
package /ActiveEcuC
  module config DummyModule: definition=ComXf, implementation-config-variant=VARIANT-PRE-COMPILE, module-description=ComXf_Impl
    DummyName (DummyContainer): DummyParam=false, DummyParam2=true, DummyParam2=false, DummyParam4=2
